## CMakeLists.txt
```
#
# Copyright (c) 2026
#
# SPDX-License-Identifier: LicenseRef-Nordic-5-Clause
#

if(CONFIG_SAP)
  zephyr_include_directories(include)
  zephyr_library()
  zephyr_library_include_directories(
    subsys/bluetooth/sap
  )
  zephyr_library_sources(
    subsys/bluetooth/sap/sap_crypto.c
    subsys/bluetooth/sap/sap_service.c
  )
endif()
```

## Kconfig
```
#
# Copyright (c) 2026
#
# SPDX-License-Identifier: LicenseRef-Nordic-5-Clause
#

menuconfig SAP
	bool "Secure Application Pairing (SAP)"
	depends on BT
	select MBEDTLS
	select MBEDTLS_PSA_CRYPTO_C
	select PSA_CRYPTO
	select PSA_WANT_GENERATE_RANDOM
	select PSA_WANT_ALG_SHA_256
	select PSA_WANT_ALG_ECDSA
	select PSA_WANT_ALG_ECDH
	select PSA_WANT_ALG_HKDF
	select PSA_WANT_ALG_HMAC
	select PSA_WANT_ALG_CCM
	select PSA_WANT_KEY_TYPE_AES
	select PSA_WANT_KEY_TYPE_DERIVE
	select PSA_WANT_KEY_TYPE_RAW_DATA
	select PSA_WANT_KEY_TYPE_ECC_PUBLIC_KEY
	select PSA_WANT_KEY_TYPE_ECC_KEY_PAIR_IMPORT
	select PSA_WANT_KEY_TYPE_ECC_KEY_PAIR_GENERATE
	select PSA_WANT_KEY_TYPE_ECC_KEY_PAIR_EXPORT
	select PSA_WANT_ECC_SECP_R1_256
	help
	  Enable the reusable Secure Application Pairing library. SAP adds
	  application-layer mutual authentication, per-connection session key
	  derivation, and AES-CCM protection for application payloads carried
	  over BLE.

if SAP

config SAP_MAX_PEERS
	int "Maximum SAP peers"
	range 1 8
	default 4
	help
	  Maximum number of concurrent SAP sessions stored in one sap_context.

config SAP_DEMO_LOGGING
	bool "Enable verbose SAP flow logging"
	default n
	help
	  Emit a step-by-step trace of the SAP handshake and post-auth state
	  transitions. This is intended for demos and walkthroughs.

config SAP_PACKET_LOGGING
	bool "Enable raw SAP packet logging"
	default n
	help
	  Emit hexdumps of the raw SAP auth packets and encrypted SAP secure
	  frames crossing the GATT transport. This is intended for protocol
	  debugging, not presentation use.

config SAP_LOG_LEVEL
	int "SAP module log level"
	default 4 if SAP_DEMO_LOGGING || SAP_PACKET_LOGGING
	default 3

endif
```

## sample.yaml
```
sample:
  name: Secure Application Pairing
tests:
  sample.bluetooth.sap.central:
    build_only: true
    platform_allow:
      - nrf54l15bsim/nrf54l15/cpuapp
      - nrf54l15dk/nrf54l15/cpuapp
    integration_platforms:
      - nrf54l15bsim/nrf54l15/cpuapp
      - nrf54l15dk/nrf54l15/cpuapp
    tags:
      - bluetooth
      - crypto
  sample.bluetooth.sap.peripheral:
    build_only: true
    extra_args: EXTRA_CONF_FILE=peripheral.conf
    platform_allow:
      - nrf54l15bsim/nrf54l15/cpuapp
      - nrf54l15dk/nrf54l15/cpuapp
    integration_platforms:
      - nrf54l15bsim/nrf54l15/cpuapp
      - nrf54l15dk/nrf54l15/cpuapp
    tags:
      - bluetooth
      - crypto
```

## prj.conf
```kconfig
#
# Copyright (c) 2026
#
# SPDX-License-Identifier: LicenseRef-Nordic-5-Clause
#

CONFIG_SYS_CLOCK_TICKS_PER_SEC=1000

CONFIG_BT=y
CONFIG_BT_SMP=y
CONFIG_BT_PRIVACY=y
CONFIG_BT_DEVICE_NAME="SAP"
CONFIG_BT_DEVICE_NAME_DYNAMIC=y
CONFIG_BT_MAX_CONN=4
CONFIG_BT_MAX_PAIRED=8
CONFIG_BT_RX_STACK_SIZE=8192
CONFIG_BT_LONG_WQ_STACK_SIZE=4096
CONFIG_BT_L2CAP_TX_MTU=300
CONFIG_BT_L2CAP_TX_FRAG_COUNT=6
CONFIG_BT_BUF_ACL_RX_SIZE=304
CONFIG_BT_BUF_ACL_TX_SIZE=251
CONFIG_BT_GATT_DYNAMIC_DB=y
CONFIG_BT_GATT_SERVICE_CHANGED=y

CONFIG_LOG=y
CONFIG_LOG_MODE_IMMEDIATE=y
CONFIG_CONSOLE=y

CONFIG_FLASH=y
CONFIG_FLASH_PAGE_LAYOUT=y
CONFIG_FLASH_MAP=y
CONFIG_NVS=y
CONFIG_SETTINGS=y
CONFIG_SETTINGS_NVS=y
CONFIG_BT_SETTINGS=y

CONFIG_MAIN_STACK_SIZE=8192
CONFIG_SYSTEM_WORKQUEUE_STACK_SIZE=4096
CONFIG_HEAP_MEM_POOL_SIZE=16384

CONFIG_ENTROPY_GENERATOR=y
CONFIG_MBEDTLS=y
CONFIG_MBEDTLS_PSA_CRYPTO_C=y
CONFIG_PSA_CRYPTO=y
CONFIG_PSA_WANT_GENERATE_RANDOM=y
CONFIG_PSA_WANT_ALG_SHA_256=y
CONFIG_PSA_WANT_ALG_ECDSA=y
CONFIG_PSA_WANT_ALG_ECDH=y
CONFIG_PSA_WANT_ALG_HKDF=y
CONFIG_PSA_WANT_ALG_HMAC=y
CONFIG_PSA_WANT_ALG_CCM=y
CONFIG_PSA_WANT_KEY_TYPE_AES=y
CONFIG_PSA_WANT_KEY_TYPE_DERIVE=y
CONFIG_PSA_WANT_KEY_TYPE_RAW_DATA=y
CONFIG_PSA_WANT_KEY_TYPE_ECC_PUBLIC_KEY=y
CONFIG_PSA_WANT_KEY_TYPE_ECC_KEY_PAIR_IMPORT=y
CONFIG_PSA_WANT_KEY_TYPE_ECC_KEY_PAIR_GENERATE=y
CONFIG_PSA_WANT_KEY_TYPE_ECC_KEY_PAIR_EXPORT=y
CONFIG_PSA_WANT_ECC_SECP_R1_256=y
```

## src/main.c
```c
/*
 * Copyright (c) 2026
 *
 * SPDX-License-Identifier: LicenseRef-Nordic-5-Clause
 */

#include <stdio.h>

#include <zephyr/kernel.h>
#include <zephyr/bluetooth/bluetooth.h>
#include <zephyr/bluetooth/conn.h>
#include <zephyr/logging/log.h>
#include <zephyr/settings/settings.h>

#include "sap_service.h"
#include "sap_credentials.h"
#include "sap_crypto.h"
#include "sap_trace.h"

LOG_MODULE_REGISTER(sap_main, CONFIG_SAP_LOG_LEVEL);

#if defined(CONFIG_SAP_ROLE_CENTRAL)
int sap_central_run(const struct sap_policy *policy);
#endif

#if defined(CONFIG_SAP_ROLE_PERIPHERAL)
int sap_peripheral_run(const struct sap_policy *policy);
#endif

static void set_name(enum sap_role role, const struct sap_device_credential *credential)
{
	char name[24];
	int err;

	snprintk(name, sizeof(name), "SAP-%c-%u",
		 (role == SAP_ROLE_CENTRAL) ? 'C' : 'P',
		 credential->cert.body.device_id);

	err = bt_set_name(name);
	if (err != 0) {
		LOG_WRN("Failed to set dynamic device name (%d)", err);
	}
}

static void pairing_complete(struct bt_conn *conn, bool bonded)
{
	struct bt_conn_info info;
	int err;

	err = bt_conn_get_info(conn, &info);
	if (err == 0) {
		LOG_INF("BLE pairing complete: bonded=%u level=%u key_size=%u",
			bonded, info.security.level, info.security.enc_key_size);
		return;
	}

	LOG_INF("BLE pairing complete: bonded=%u", bonded);
}

static void pairing_failed(struct bt_conn *conn, enum bt_security_err err)
{
	ARG_UNUSED(conn);
	LOG_ERR("BLE pairing failed: %d %s", err, bt_security_err_to_str(err));
}

static struct bt_conn_auth_info_cb auth_info_cb = {
	.pairing_complete = pairing_complete,
	.pairing_failed = pairing_failed,
};

int main(void)
{
	enum sap_role role = IS_ENABLED(CONFIG_SAP_ROLE_CENTRAL) ?
		SAP_ROLE_CENTRAL : SAP_ROLE_PERIPHERAL;
	const struct sap_device_credential *local_credential;
	struct sap_policy policy;
	size_t ca_len;
	int err;

	local_credential = sap_credentials_select(role);
	memset(&policy, 0, sizeof(policy));
	policy.local_credential = local_credential;
	policy.ca_public_key = sap_credentials_ca_public_key(&ca_len);
	policy.ca_public_key_len = ca_len;
	policy.expected_group_id = CONFIG_SAP_EXPECTED_GROUP_ID;
	policy.allowed_central_id = CONFIG_SAP_ALLOWED_CENTRAL_ID;
	policy.require_ble_encryption = IS_ENABLED(CONFIG_SAP_REQUIRE_BLE_ENCRYPTION);

	err = sap_crypto_init();
	if (err != 0) {
		LOG_ERR("PSA crypto init failed (%d)", err);
		return 0;
	}

	err = bt_enable(NULL);
	if (err != 0) {
		LOG_ERR("Bluetooth init failed (%d)", err);
		return 0;
	}

	if (IS_ENABLED(CONFIG_SETTINGS)) {
		err = settings_load();
		if (err != 0) {
			LOG_ERR("Settings load failed (%d)", err);
			return 0;
		}

		if (IS_ENABLED(CONFIG_SAP_DEMO_LOGGING)) {
			SAP_TRACE("FLOW 0/8 Bluetooth settings restored from NVS");
		}
	}

	err = bt_conn_auth_info_cb_register(&auth_info_cb);
	if (err != 0) {
		LOG_ERR("Failed to register pairing diagnostics (%d)", err);
		return 0;
	}

	set_name(role, local_credential);

	LOG_INF("SAP sample starting as %s, local device id %u",
		(role == SAP_ROLE_CENTRAL) ? "central" : "peripheral",
		local_credential->cert.body.device_id);
	if (IS_ENABLED(CONFIG_SAP_DEMO_LOGGING)) {
		SAP_TRACE("FLOW 0/8 local policy: group=0x%02x allowed_central=%u ble_encryption=%u",
			  policy.expected_group_id, policy.allowed_central_id,
			  policy.require_ble_encryption);
	}

	if (IS_ENABLED(CONFIG_SAP_REQUIRE_BLE_ENCRYPTION) &&
	    IS_ENABLED(CONFIG_BOARD_NRF54L15BSIM)) {
		LOG_WRN("BLE encryption is enabled on nrf54l15bsim even though local BabbleSim validation is not reliable");
	}

#if defined(CONFIG_SAP_ROLE_CENTRAL)
	return sap_central_run(&policy);
#else
	return sap_peripheral_run(&policy);
#endif
}
```

## src/sap_credentials.c
```c
/*
 * Copyright (c) 2026
 *
 * SPDX-License-Identifier: LicenseRef-Nordic-5-Clause
 */

#include <zephyr/kernel.h>

#include "sap_credentials.h"

#if defined(CONFIG_BOARD_NRF54L15BSIM)
extern unsigned int bsim_args_get_global_device_nbr(void);
#endif

static const uint8_t sap_ca_public_key[SAP_IDENTITY_PUBLIC_KEY_LEN] = {
	0x04, 0x73, 0x97, 0x1e, 0xc4, 0x4f, 0x91, 0xce,
	0xf2, 0xb3, 0xae, 0xb6, 0x24, 0xeb, 0x23, 0xec,
	0x05, 0xd4, 0x04, 0xca, 0x6b, 0x43, 0x88, 0x68,
	0x79, 0x07, 0xe1, 0xde, 0xf1, 0x4b, 0xa9, 0x3f,
	0x65, 0x59, 0x40, 0xdd, 0x63, 0x20, 0xa0, 0x34,
	0xda, 0xa9, 0x65, 0x65, 0xbe, 0x25, 0xcc, 0x3b,
	0xa5, 0x19, 0x21, 0xd1, 0x8f, 0xac, 0x5d, 0x85,
	0xb4, 0xe1, 0x00, 0x34, 0xca, 0x71, 0x2d, 0x1d,
	0x93,
};

#define SAP_GROUP_ID 0x2A

static const struct sap_device_credential central_credentials[] = {
	{
		.simulated_device_number = 0,
		.private_key = {
			0x98, 0xdc, 0x64, 0x32, 0xc0, 0xd5, 0xfb, 0x66,
			0xf6, 0x02, 0x2b, 0xa1, 0xdf, 0x9c, 0x5c, 0xc6,
			0x0e, 0x96, 0xc4, 0xff, 0x0b, 0x6c, 0x4e, 0xc6,
			0xce, 0xaa, 0xe9, 0x17, 0x7d, 0x70, 0x28, 0x26,
		},
		.cert = {
			.body = {
				.version = SAP_VERSION,
				.role_mask = SAP_ROLE_MASK_CENTRAL,
				.device_id = 0,
				.group_id = SAP_GROUP_ID,
				.public_key = {
					0x04, 0x46, 0x84, 0x5c, 0x0a, 0x25, 0xf1, 0x58,
					0x75, 0x31, 0x74, 0x40, 0xc8, 0x2a, 0xca, 0x9a,
					0xfb, 0x7a, 0x5e, 0x7e, 0xae, 0x5e, 0x05, 0xd4,
					0x3c, 0x97, 0xef, 0xd4, 0xc8, 0x17, 0x25, 0xdc,
					0x61, 0xea, 0xbb, 0x72, 0x46, 0xc1, 0x45, 0x82,
					0x5c, 0x88, 0x29, 0xba, 0xf9, 0x7a, 0x26, 0x83,
					0xc0, 0x75, 0xaa, 0x0b, 0x53, 0xce, 0xa5, 0xf5,
					0x71, 0x3e, 0xb8, 0x12, 0x8e, 0x23, 0xb5, 0x8f,
					0x37,
				},
			},
			.ca_signature = {
				0xfc, 0x73, 0x32, 0xff, 0x63, 0x62, 0xa6, 0xfa,
				0x6c, 0x0a, 0x45, 0x25, 0xc1, 0x16, 0xb1, 0x00,
				0x4d, 0x67, 0x93, 0x9f, 0x24, 0xa3, 0x07, 0x1f,
				0x6e, 0xa5, 0xdf, 0xdd, 0x36, 0x97, 0xd2, 0x16,
				0x7e, 0xe7, 0x45, 0x72, 0xe3, 0x13, 0x17, 0x1f,
				0x91, 0xcd, 0x70, 0xbe, 0x98, 0x48, 0xab, 0x18,
				0x21, 0x2d, 0xb0, 0xe1, 0x75, 0xd0, 0xf3, 0x4c,
				0x75, 0x06, 0xc6, 0x12, 0x03, 0x77, 0x35, 0x91,
			},
		},
	},
};

static const struct sap_device_credential peripheral_credentials[] = {
	{
		.simulated_device_number = 1,
		.private_key = {
			0xf8, 0xf0, 0xb5, 0xf0, 0xe0, 0x26, 0x4d, 0xf6,
			0x14, 0xc6, 0x60, 0x5d, 0x5c, 0xe6, 0xd3, 0xbc,
			0x2b, 0x60, 0xbf, 0x71, 0x5c, 0x68, 0x60, 0x7e,
			0xfa, 0x12, 0xb0, 0x02, 0x1f, 0xa1, 0x85, 0xfc,
		},
		.cert = {
			.body = {
				.version = SAP_VERSION,
				.role_mask = SAP_ROLE_MASK_PERIPHERAL,
				.device_id = 1,
				.group_id = SAP_GROUP_ID,
				.public_key = {
					0x04, 0x76, 0x28, 0xad, 0x66, 0xab, 0x16, 0x11,
					0xd3, 0x65, 0x03, 0x43, 0xe8, 0xa1, 0x6f, 0xd7,
					0x5a, 0xae, 0xe2, 0xdd, 0x6a, 0x96, 0x07, 0xf9,
					0x76, 0x4d, 0xef, 0x90, 0x3d, 0xec, 0x0c, 0xd8,
					0xcb, 0xf9, 0xc3, 0x6a, 0x38, 0xd8, 0xaf, 0xd0,
					0x45, 0x15, 0x46, 0x37, 0x81, 0x7e, 0xf6, 0x67,
					0xf8, 0x7b, 0x74, 0x75, 0x17, 0x56, 0xbd, 0x58,
					0xad, 0x4e, 0x88, 0x67, 0xe6, 0xcc, 0xe2, 0x08,
					0x87,
				},
			},
			.ca_signature = {
				0x94, 0x08, 0x61, 0x06, 0xee, 0x62, 0xb4, 0x6c,
				0x62, 0x83, 0x05, 0x4d, 0x7b, 0x9b, 0x62, 0x5e,
				0x0a, 0x3e, 0xa2, 0x48, 0xff, 0x33, 0xac, 0x78,
				0x62, 0x10, 0xc3, 0x0e, 0x54, 0x1a, 0xa5, 0x18,
				0x20, 0xee, 0xec, 0x0d, 0x8c, 0xc1, 0xd3, 0xe1,
				0x9e, 0x83, 0x39, 0x32, 0x71, 0x4d, 0x9f, 0xf7,
				0x69, 0x71, 0xf0, 0xe4, 0xde, 0xd8, 0x5c, 0xc4,
				0xe9, 0x4d, 0x68, 0xe6, 0xdd, 0x9d, 0x26, 0x50,
			},
		},
	},
	{
		.simulated_device_number = 2,
		.private_key = {
			0xee, 0xfc, 0xfc, 0x7b, 0x1e, 0xd1, 0x24, 0x11,
			0x87, 0x83, 0xc8, 0x23, 0x6e, 0xf4, 0x50, 0x2e,
			0x01, 0xe8, 0xf0, 0x7a, 0xb4, 0xdf, 0x13, 0x48,
			0xa4, 0x25, 0xa5, 0x13, 0x85, 0x3f, 0x5f, 0x36,
		},
		.cert = {
			.body = {
				.version = SAP_VERSION,
				.role_mask = SAP_ROLE_MASK_PERIPHERAL,
				.device_id = 2,
				.group_id = SAP_GROUP_ID,
				.public_key = {
					0x04, 0x4c, 0x71, 0x05, 0x43, 0xba, 0x7f, 0xa3,
					0x26, 0xa3, 0x47, 0x4e, 0xfe, 0xf2, 0x61, 0x12,
					0x39, 0xa6, 0x8f, 0x67, 0xd5, 0xd7, 0x23, 0xfe,
					0x73, 0xfc, 0x74, 0xf8, 0x69, 0xd8, 0xbd, 0x8a,
					0xb2, 0xef, 0x18, 0x19, 0x16, 0x80, 0x9e, 0x2b,
					0x71, 0xdb, 0x27, 0x0c, 0xc4, 0x74, 0x53, 0x70,
					0xfd, 0x57, 0xb1, 0x0b, 0x5b, 0x56, 0xde, 0x1a,
					0xfb, 0x24, 0xe0, 0x9a, 0x56, 0x06, 0x47, 0xe5,
					0xe6,
				},
			},
			.ca_signature = {
				0x93, 0x36, 0x2e, 0x6d, 0xb0, 0xfc, 0x7f, 0xd9,
				0xa6, 0xb9, 0x11, 0xa5, 0x94, 0xb7, 0x2d, 0x54,
				0x12, 0x64, 0x61, 0xf1, 0x1b, 0x67, 0x54, 0x35,
				0x72, 0x2f, 0x3c, 0x3a, 0xf7, 0x50, 0xf3, 0xf7,
				0x89, 0xa9, 0x2d, 0xb7, 0x26, 0xee, 0x61, 0x1e,
				0x47, 0xbc, 0xd1, 0x48, 0xa2, 0x84, 0x2c, 0xb7,
				0x84, 0x1d, 0x6a, 0x4a, 0xd6, 0x66, 0xa2, 0xa2,
				0x2e, 0x19, 0xae, 0xe5, 0x57, 0x29, 0x84, 0x09,
			},
		},
	},
	{
		.simulated_device_number = 3,
		.private_key = {
			0x24, 0x0d, 0x9f, 0xaa, 0x75, 0x73, 0xbf, 0x6a,
			0xf4, 0x98, 0xd5, 0xee, 0x47, 0x27, 0x3c, 0x52,
			0xdd, 0x6c, 0xb2, 0xbc, 0xef, 0x2e, 0x4b, 0x12,
			0x63, 0x37, 0x4f, 0x73, 0x5a, 0x98, 0x80, 0x70,
		},
		.cert = {
			.body = {
				.version = SAP_VERSION,
				.role_mask = SAP_ROLE_MASK_PERIPHERAL,
				.device_id = 3,
				.group_id = SAP_GROUP_ID,
				.public_key = {
					0x04, 0x9d, 0x8e, 0x25, 0x76, 0x83, 0xee, 0xa9,
					0xb4, 0xdd, 0xd0, 0xca, 0xda, 0x25, 0x82, 0x41,
					0x53, 0x7f, 0xf4, 0xbb, 0xab, 0xb1, 0x11, 0x50,
					0x28, 0x49, 0xbf, 0xe1, 0x4b, 0x33, 0xe1, 0x5f,
					0x13, 0xaa, 0x55, 0x58, 0xdb, 0xf9, 0x54, 0x1c,
					0xb3, 0x7a, 0x8d, 0xe7, 0x7d, 0xba, 0x72, 0x2e,
					0x06, 0x4a, 0xd6, 0xbc, 0x99, 0xe9, 0xe8, 0xd4,
					0xea, 0x81, 0x16, 0x8e, 0x67, 0x6f, 0x87, 0x39,
					0x21,
				},
			},
			.ca_signature = {
				0x1d, 0x04, 0x50, 0xa3, 0x59, 0xa4, 0xdb, 0x1c,
				0xcf, 0x7d, 0xf4, 0xd5, 0x4e, 0x2e, 0x08, 0x6f,
				0x29, 0x0c, 0x82, 0xf9, 0x80, 0x95, 0x24, 0x03,
				0x7c, 0xda, 0x00, 0xd8, 0xed, 0xee, 0x7f, 0x3f,
				0xe1, 0x94, 0xa5, 0x61, 0x5d, 0xf5, 0x09, 0x18,
				0xc8, 0xae, 0x48, 0xbd, 0xcc, 0xb9, 0x45, 0xba,
				0xc3, 0xa4, 0x2b, 0x9b, 0x2d, 0x01, 0xe2, 0xbf,
				0x61, 0x9a, 0x44, 0x21, 0x85, 0x76, 0x4a, 0xd6,
			},
		},
	},
	{
		.simulated_device_number = 4,
		.private_key = {
			0x04, 0x9f, 0xb5, 0x56, 0x70, 0x44, 0xef, 0x8e,
			0x4d, 0x7d, 0x5d, 0x7d, 0x82, 0xe4, 0x08, 0x47,
			0x86, 0x24, 0x49, 0xe6, 0x22, 0xbd, 0x6d, 0xa3,
			0x80, 0x0b, 0xc4, 0x9e, 0xb2, 0x23, 0x16, 0x6d,
		},
		.cert = {
			.body = {
				.version = SAP_VERSION,
				.role_mask = SAP_ROLE_MASK_PERIPHERAL,
				.device_id = 4,
				.group_id = SAP_GROUP_ID,
				.public_key = {
					0x04, 0x38, 0x2e, 0xed, 0x51, 0xd2, 0x8c, 0x40,
					0x59, 0x33, 0xc9, 0x04, 0x63, 0x5e, 0xaf, 0x8e,
					0x6e, 0xb5, 0xe3, 0xf6, 0x83, 0xe0, 0xd7, 0x80,
					0xf5, 0x19, 0x72, 0x5a, 0x84, 0x88, 0x07, 0x4d,
					0x56, 0x43, 0x99, 0xf1, 0x97, 0xbe, 0x26, 0xe2,
					0xef, 0x9c, 0xa2, 0xf4, 0x28, 0x1a, 0xbd, 0x88,
					0x75, 0xee, 0xde, 0x1f, 0x2f, 0x25, 0xb9, 0xf4,
					0x4b, 0xa9, 0x98, 0xc7, 0x90, 0x76, 0x52, 0xf4,
					0x14,
				},
			},
			.ca_signature = {
				0x3f, 0x3b, 0x48, 0x0c, 0xba, 0xd4, 0xeb, 0xd9,
				0x94, 0xdd, 0x4c, 0x99, 0x9e, 0xb2, 0x5f, 0x6f,
				0xc3, 0x50, 0x54, 0x22, 0xa1, 0xde, 0x2a, 0xdb,
				0xd1, 0x59, 0xf6, 0xe9, 0x37, 0x55, 0x9e, 0xf5,
				0x38, 0xb3, 0xea, 0x28, 0xf8, 0xa6, 0x34, 0x2b,
				0xe5, 0xe1, 0xba, 0xec, 0xab, 0xe6, 0x34, 0x34,
				0xa1, 0xe5, 0x65, 0x58, 0x9d, 0xfe, 0xd8, 0x7b,
				0x70, 0xa0, 0x39, 0x22, 0xb1, 0xf9, 0x41, 0x76,
			},
		},
	},
};

static unsigned int simulated_device_number(void)
{
#if defined(CONFIG_BOARD_NRF54L15BSIM)
	return bsim_args_get_global_device_nbr();
#else
	return 0U;
#endif
}

const struct sap_device_credential *sap_credentials_select(enum sap_role role)
{
	size_t i;
	unsigned int dev_num = simulated_device_number();

	if (role == SAP_ROLE_CENTRAL) {
		return &central_credentials[0];
	}

	for (i = 0; i < ARRAY_SIZE(peripheral_credentials); i++) {
		if (peripheral_credentials[i].simulated_device_number == dev_num) {
			return &peripheral_credentials[i];
		}
	}

	return &peripheral_credentials[0];
}

const uint8_t *sap_credentials_ca_public_key(size_t *len)
{
	if (len != NULL) {
		*len = sizeof(sap_ca_public_key);
	}

	return sap_ca_public_key;
}
```

## src/sap_credentials.h
```c
/*
 * Copyright (c) 2026
 *
 * SPDX-License-Identifier: LicenseRef-Nordic-5-Clause
 */

#ifndef SAP_CREDENTIALS_H__
#define SAP_CREDENTIALS_H__

#include <zephyr/types.h>

#include "sap_protocol.h"

struct sap_device_credential {
	uint8_t simulated_device_number;
	uint8_t private_key[SAP_IDENTITY_PRIVATE_KEY_LEN];
	struct sap_certificate cert;
};

const struct sap_device_credential *sap_credentials_select(enum sap_role role);
const uint8_t *sap_credentials_ca_public_key(size_t *len);

#endif /* SAP_CREDENTIALS_H__ */
```

## src/sap_crypto.c
```c
/*
 * Copyright (c) 2026
 *
 * SPDX-License-Identifier: LicenseRef-Nordic-5-Clause
 */

#include <errno.h>
#include <string.h>

#include "sap_protocol.h"
#include "sap_crypto.h"

int sap_crypto_hash_sha256(const uint8_t *message, size_t message_len,
			   uint8_t *hash, size_t hash_size)
{
	psa_status_t status;
	size_t hash_len;

	status = psa_hash_compute(PSA_ALG_SHA_256, message, message_len, hash,
				  hash_size, &hash_len);
	if (status != PSA_SUCCESS || hash_len != 32U) {
		return -EIO;
	}

	return 0;
}

int sap_crypto_init(void)
{
	psa_status_t status = psa_crypto_init();

	return (status == PSA_SUCCESS) ? 0 : -EIO;
}

void sap_crypto_destroy_key(psa_key_id_t *key_id)
{
	if ((*key_id) == 0) {
		return;
	}

	(void)psa_destroy_key(*key_id);
	*key_id = 0;
}

int sap_crypto_import_identity_private(const uint8_t *key, size_t key_len,
				       psa_key_id_t *key_id)
{
	psa_key_attributes_t attributes = PSA_KEY_ATTRIBUTES_INIT;
	psa_status_t status;

	psa_set_key_usage_flags(&attributes, PSA_KEY_USAGE_SIGN_HASH);
	psa_set_key_lifetime(&attributes, PSA_KEY_LIFETIME_VOLATILE);
	psa_set_key_algorithm(&attributes, PSA_ALG_ECDSA(PSA_ALG_SHA_256));
	psa_set_key_type(&attributes,
			 PSA_KEY_TYPE_ECC_KEY_PAIR(PSA_ECC_FAMILY_SECP_R1));
	psa_set_key_bits(&attributes, 256);

	status = psa_import_key(&attributes, key, key_len, key_id);
	psa_reset_key_attributes(&attributes);

	return (status == PSA_SUCCESS) ? 0 : -EIO;
}

int sap_crypto_verify_identity(const uint8_t *public_key, size_t public_key_len,
			       const uint8_t *message, size_t message_len,
			       const uint8_t *signature, size_t signature_len)
{
	psa_key_attributes_t attributes = PSA_KEY_ATTRIBUTES_INIT;
	psa_key_id_t key_id = 0;
	uint8_t hash[32];
	psa_status_t status;
	int err = 0;

	psa_set_key_usage_flags(&attributes, PSA_KEY_USAGE_VERIFY_HASH);
	psa_set_key_lifetime(&attributes, PSA_KEY_LIFETIME_VOLATILE);
	psa_set_key_algorithm(&attributes, PSA_ALG_ECDSA(PSA_ALG_SHA_256));
	psa_set_key_type(&attributes,
			 PSA_KEY_TYPE_ECC_PUBLIC_KEY(PSA_ECC_FAMILY_SECP_R1));
	psa_set_key_bits(&attributes, 256);

	status = psa_import_key(&attributes, public_key, public_key_len, &key_id);
	psa_reset_key_attributes(&attributes);
	if (status != PSA_SUCCESS) {
		return -EIO;
	}

	err = sap_crypto_hash_sha256(message, message_len, hash, sizeof(hash));
	if (err != 0) {
		sap_crypto_destroy_key(&key_id);
		return err;
	}

	status = psa_verify_hash(key_id, PSA_ALG_ECDSA(PSA_ALG_SHA_256), hash,
				 sizeof(hash), signature, signature_len);
	if (status != PSA_SUCCESS) {
		err = -EKEYREJECTED;
	}

	sap_crypto_destroy_key(&key_id);
	return err;
}

int sap_crypto_sign_identity(psa_key_id_t key_id, const uint8_t *message,
			     size_t message_len, uint8_t *signature,
			     size_t signature_size, size_t *signature_len)
{
	uint8_t hash[32];
	psa_status_t status;
	int err;

	err = sap_crypto_hash_sha256(message, message_len, hash, sizeof(hash));
	if (err != 0) {
		return err;
	}

	status = psa_sign_hash(key_id, PSA_ALG_ECDSA(PSA_ALG_SHA_256), hash,
			       sizeof(hash), signature, signature_size,
			       signature_len);
	return (status == PSA_SUCCESS) ? 0 : -EIO;
}

int sap_crypto_generate_ecdh_keypair(psa_key_id_t *key_id)
{
	psa_key_attributes_t attributes = PSA_KEY_ATTRIBUTES_INIT;
	psa_status_t status;

	psa_set_key_usage_flags(&attributes, PSA_KEY_USAGE_DERIVE);
	psa_set_key_lifetime(&attributes, PSA_KEY_LIFETIME_VOLATILE);
	psa_set_key_algorithm(&attributes, PSA_ALG_ECDH);
	psa_set_key_type(&attributes,
			 PSA_KEY_TYPE_ECC_KEY_PAIR(PSA_ECC_FAMILY_SECP_R1));
	psa_set_key_bits(&attributes, 256);

	status = psa_generate_key(&attributes, key_id);
	psa_reset_key_attributes(&attributes);

	return (status == PSA_SUCCESS) ? 0 : -EIO;
}

int sap_crypto_export_public_key(psa_key_id_t key_id, uint8_t *buffer,
				 size_t buffer_size, size_t *buffer_len)
{
	psa_status_t status;

	status = psa_export_public_key(key_id, buffer, buffer_size, buffer_len);
	return (status == PSA_SUCCESS) ? 0 : -EIO;
}

int sap_crypto_calculate_shared_secret(psa_key_id_t key_id,
				       const uint8_t *peer_public_key,
				       size_t peer_public_key_len,
				       uint8_t *secret, size_t secret_size,
				       size_t *secret_len)
{
	psa_status_t status;

	status = psa_raw_key_agreement(PSA_ALG_ECDH, key_id, peer_public_key,
				       peer_public_key_len, secret,
				       secret_size, secret_len);
	return (status == PSA_SUCCESS) ? 0 : -EIO;
}

int sap_crypto_hkdf_sha256(const uint8_t *secret, size_t secret_len,
			   const uint8_t *salt, size_t salt_len,
			   const uint8_t *info, size_t info_len,
			   uint8_t *output, size_t output_len)
{
	psa_key_attributes_t input_attributes = PSA_KEY_ATTRIBUTES_INIT;
	psa_key_derivation_operation_t operation =
		PSA_KEY_DERIVATION_OPERATION_INIT;
	psa_key_id_t secret_id = 0;
	psa_status_t status;
	int err = 0;

	psa_set_key_usage_flags(&input_attributes, PSA_KEY_USAGE_DERIVE);
	psa_set_key_lifetime(&input_attributes, PSA_KEY_LIFETIME_VOLATILE);
	psa_set_key_algorithm(&input_attributes, PSA_ALG_HKDF(PSA_ALG_SHA_256));
	psa_set_key_type(&input_attributes, PSA_KEY_TYPE_DERIVE);
	psa_set_key_bits(&input_attributes, secret_len * 8U);

	status = psa_import_key(&input_attributes, secret, secret_len, &secret_id);
	psa_reset_key_attributes(&input_attributes);
	if (status != PSA_SUCCESS) {
		return -EIO;
	}

	status = psa_key_derivation_setup(&operation, PSA_ALG_HKDF(PSA_ALG_SHA_256));
	if (status != PSA_SUCCESS) {
		err = -EIO;
		goto out;
	}

	status = psa_key_derivation_input_bytes(&operation,
						PSA_KEY_DERIVATION_INPUT_SALT,
						salt, salt_len);
	if (status != PSA_SUCCESS) {
		err = -EIO;
		goto out;
	}

	status = psa_key_derivation_input_key(&operation,
					      PSA_KEY_DERIVATION_INPUT_SECRET,
					      secret_id);
	if (status != PSA_SUCCESS) {
		err = -EIO;
		goto out;
	}

	status = psa_key_derivation_input_bytes(&operation,
						PSA_KEY_DERIVATION_INPUT_INFO,
						info, info_len);
	if (status != PSA_SUCCESS) {
		err = -EIO;
		goto out;
	}

	status = psa_key_derivation_output_bytes(&operation, output, output_len);
	if (status != PSA_SUCCESS) {
		err = -EIO;
	}

out:
	(void)psa_key_derivation_abort(&operation);
	sap_crypto_destroy_key(&secret_id);
	return err;
}

int sap_crypto_import_aes_ccm_key(const uint8_t *key, size_t key_len,
				  psa_key_id_t *key_id)
{
	psa_key_attributes_t attributes = PSA_KEY_ATTRIBUTES_INIT;
	psa_status_t status;

	psa_set_key_usage_flags(&attributes,
				PSA_KEY_USAGE_ENCRYPT | PSA_KEY_USAGE_DECRYPT);
	psa_set_key_lifetime(&attributes, PSA_KEY_LIFETIME_VOLATILE);
	psa_set_key_algorithm(&attributes, PSA_ALG_CCM);
	psa_set_key_type(&attributes, PSA_KEY_TYPE_AES);
	psa_set_key_bits(&attributes, key_len * 8U);

	status = psa_import_key(&attributes, key, key_len, key_id);
	psa_reset_key_attributes(&attributes);

	return (status == PSA_SUCCESS) ? 0 : -EIO;
}

int sap_crypto_aead_encrypt(psa_key_id_t key_id, const uint8_t *nonce,
			    size_t nonce_len, const uint8_t *aad,
			    size_t aad_len, const uint8_t *plaintext,
			    size_t plaintext_len, uint8_t *ciphertext,
			    size_t ciphertext_size, size_t *ciphertext_len)
{
	psa_status_t status;

	status = psa_aead_encrypt(key_id, PSA_ALG_CCM, nonce, nonce_len, aad,
				  aad_len, plaintext, plaintext_len, ciphertext,
				  ciphertext_size, ciphertext_len);
	return (status == PSA_SUCCESS) ? 0 : -EIO;
}

int sap_crypto_aead_decrypt(psa_key_id_t key_id, const uint8_t *nonce,
			    size_t nonce_len, const uint8_t *aad,
			    size_t aad_len, const uint8_t *ciphertext,
			    size_t ciphertext_len, uint8_t *plaintext,
			    size_t plaintext_size, size_t *plaintext_len)
{
	psa_status_t status;

	status = psa_aead_decrypt(key_id, PSA_ALG_CCM, nonce, nonce_len, aad,
				  aad_len, ciphertext, ciphertext_len, plaintext,
				  plaintext_size, plaintext_len);
	return (status == PSA_SUCCESS) ? 0 : -EIO;
}
```

## src/sap_peripheral.c
```c
/*
 * Copyright (c) 2026
 *
 * SPDX-License-Identifier: LicenseRef-Nordic-5-Clause
 */

#include <errno.h>
#include <stdio.h>
#include <string.h>

#include <zephyr/kernel.h>
#include <zephyr/sys/util.h>
#include <zephyr/logging/log.h>
#include <zephyr/bluetooth/bluetooth.h>
#include <zephyr/bluetooth/conn.h>
#include <zephyr/bluetooth/gatt.h>
#include <zephyr/bluetooth/hci.h>

#if defined(CONFIG_SAP_SHELL)
#include <zephyr/shell/shell.h>
#endif

#if defined(CONFIG_SAP_DK_IO)
#include <dk_buttons_and_leds.h>
#endif

#include "sap_service.h"
#include "sap_trace.h"

LOG_MODULE_REGISTER(sap_peripheral, CONFIG_SAP_LOG_LEVEL);

#define SAP_ADV_RESTART_DELAY_MS 250
#define SAP_SECURITY_FAILURE_RETRY_MS 1000

#if defined(CONFIG_SAP_DK_IO)
#define SAP_BUTTON_MASK DK_BTN1_MSK
#endif

static struct sap_context sap_ctx;
static bool protected_registered;
static bool connection_active;
static bool advertising_restart_pending;
static void advertising_start(void);

static void advertising_retry_fn(struct k_work *work);
K_WORK_DELAYABLE_DEFINE(advertising_retry_work, advertising_retry_fn);

#if defined(CONFIG_SAP_DK_IO)
static bool button_pressed;
static void button_report_fn(struct k_work *work);
K_WORK_DEFINE(button_report_work, button_report_fn);
#endif

static const uint8_t sap_ad_flags[] = {
	BT_LE_AD_GENERAL | BT_LE_AD_NO_BREDR,
};

static const uint8_t sap_service_uuid[] = {
	BT_UUID_SAP_SERVICE_VAL,
};

static const struct bt_data sap_ad[] = {
	BT_DATA(BT_DATA_FLAGS, sap_ad_flags, sizeof(sap_ad_flags)),
	BT_DATA(BT_DATA_UUID128_ALL, sap_service_uuid, sizeof(sap_service_uuid)),
};

static ssize_t sap_auth_write(struct bt_conn *conn,
			      const struct bt_gatt_attr *attr,
			      const void *buf, uint16_t len, uint16_t offset,
			      uint8_t flags);
static ssize_t sap_secure_rx_write(struct bt_conn *conn,
				   const struct bt_gatt_attr *attr,
				   const void *buf, uint16_t len, uint16_t offset,
				   uint8_t flags);
static ssize_t protected_status_read(struct bt_conn *conn,
				     const struct bt_gatt_attr *attr,
				     void *buf, uint16_t len, uint16_t offset);

BT_GATT_SERVICE_DEFINE(sap_svc,
	BT_GATT_PRIMARY_SERVICE(BT_UUID_SAP_SERVICE),
	BT_GATT_CHARACTERISTIC(BT_UUID_SAP_AUTH,
			       BT_GATT_CHRC_WRITE_WITHOUT_RESP | BT_GATT_CHRC_NOTIFY,
			       BT_GATT_PERM_WRITE, NULL, sap_auth_write, NULL),
	BT_GATT_CCC(NULL, BT_GATT_PERM_READ | BT_GATT_PERM_WRITE),
	BT_GATT_CHARACTERISTIC(BT_UUID_SAP_SECURE_TX,
			       BT_GATT_CHRC_NOTIFY,
			       BT_GATT_PERM_NONE, NULL, NULL, NULL),
	BT_GATT_CCC(NULL, BT_GATT_PERM_READ | BT_GATT_PERM_WRITE),
	BT_GATT_CHARACTERISTIC(BT_UUID_SAP_SECURE_RX,
			       BT_GATT_CHRC_WRITE_WITHOUT_RESP,
			       BT_GATT_PERM_WRITE, NULL, sap_secure_rx_write, NULL));

static struct bt_gatt_attr protected_attrs[] = {
	BT_GATT_PRIMARY_SERVICE(BT_UUID_SAP_PROTECTED_SERVICE),
	BT_GATT_CHARACTERISTIC(BT_UUID_SAP_PROTECTED_STATUS,
			       BT_GATT_CHRC_READ,
			       BT_GATT_PERM_READ,
			       protected_status_read, NULL, NULL),
};

static struct bt_gatt_service protected_svc = BT_GATT_SERVICE(protected_attrs);

#define SAP_AUTH_ATTR_INDEX 2
#define SAP_SECURE_TX_ATTR_INDEX 5

#if defined(CONFIG_SAP_SHELL) || defined(CONFIG_SAP_DK_IO)
static struct sap_session *active_session(bool require_authenticated)
{
	size_t i;

	for (i = 0; i < ARRAY_SIZE(sap_ctx.sessions); i++) {
		struct sap_session *session = &sap_ctx.sessions[i];

		if (!session->in_use || (session->conn == NULL)) {
			continue;
		}

		if (require_authenticated && !sap_is_authenticated(session)) {
			continue;
		}

		return session;
	}

	return NULL;
}
#endif

static void protected_service_disable(void)
{
	if (!protected_registered) {
		return;
	}

	(void)bt_gatt_service_unregister(&protected_svc);
	protected_registered = false;
}

static void protected_service_enable(void)
{
	int err;

	if (protected_registered) {
		return;
	}

	err = bt_gatt_service_register(&protected_svc);
	if (err != 0) {
		LOG_ERR("Failed to register protected service (%d)", err);
		return;
	}

	protected_registered = true;
	LOG_INF("Protected service registered");
	SAP_TRACE("FLOW post-auth: peripheral exposed the protected service after SAP success");
}

static bool should_clear_bond(enum bt_security_err err)
{
	switch (err) {
	case BT_SECURITY_ERR_AUTH_FAIL:
	case BT_SECURITY_ERR_PIN_OR_KEY_MISSING:
	case BT_SECURITY_ERR_AUTH_REQUIREMENT:
	case BT_SECURITY_ERR_KEY_REJECTED:
		return true;
	default:
		return false;
	}
}

static void clear_bond_on_security_failure(struct bt_conn *conn,
					   enum bt_security_err err)
{
	int clear_err;

	if (!IS_ENABLED(CONFIG_BT_SETTINGS) || !should_clear_bond(err)) {
		return;
	}

	clear_err = bt_unpair(BT_ID_DEFAULT, bt_conn_get_dst(conn));
	if (clear_err == 0) {
		LOG_WRN("Cleared stale bond after security failure: %s",
			bt_security_err_to_str(err));
	} else if (clear_err != -ENOENT) {
		LOG_WRN("Failed to clear stale bond (%d)", clear_err);
	}
}

static int send_auth(struct sap_session *session, const uint8_t *data, size_t len)
{
	return bt_gatt_notify(session->conn, &sap_svc.attrs[SAP_AUTH_ATTR_INDEX], data,
			      len);
}

static int send_secure(struct sap_session *session, const uint8_t *data, size_t len)
{
	return bt_gatt_notify(session->conn, &sap_svc.attrs[SAP_SECURE_TX_ATTR_INDEX],
			      data, len);
}

static void on_authenticated(struct sap_session *session)
{
	LOG_INF("SAP authenticated with central %u", session->peer_cert.body.device_id);
	SAP_TRACE("FLOW post-auth: peripheral now allows protected-service access for central %u",
		  session->peer_cert.body.device_id);
	protected_service_enable();

#if defined(CONFIG_SAP_DK_IO)
	(void)k_work_submit(&button_report_work);
#endif
}

static void on_auth_failed(struct sap_session *session, int reason)
{
	LOG_ERR("SAP auth failed on peripheral side (%d)", reason);
	protected_service_disable();
	if (session->conn != NULL) {
		(void)bt_conn_disconnect(session->conn, BT_HCI_ERR_REMOTE_USER_TERM_CONN);
	}
}

static void on_secure_payload(struct sap_session *session, uint8_t msg_type,
			      const uint8_t *data, size_t len)
{
	char response[48];
	int resp_len;

	if (msg_type != SAP_MSG_SECURE_DATA) {
		return;
	}

	LOG_INF("Secure payload from central: %.*s", len, (const char *)data);
	SAP_TRACE("FLOW post-auth: peripheral accepted encrypted application payload from central");
	resp_len = snprintk(response, sizeof(response), "ack-%u",
			    session->ctx->policy.local_credential->cert.body.device_id);
	(void)sap_send_secure(session, SAP_MSG_SECURE_ACK,
			      (const uint8_t *)response, (size_t)resp_len);
}

#if defined(CONFIG_SAP_DK_IO)
static void button_report_fn(struct k_work *work)
{
	struct sap_session *session;
	uint8_t payload;
	int err;

	ARG_UNUSED(work);

	session = active_session(true);
	if (session == NULL) {
		return;
	}

	payload = button_pressed ? 1U : 0U;
	err = sap_send_secure(session, SAP_MSG_BUTTON_STATE, &payload, sizeof(payload));
	if (err != 0) {
		LOG_ERR("Failed to send secure button state (%d)", err);
		return;
	}

	SAP_TRACE("FLOW app-io: peripheral sent button 1 state %u to the central",
		  payload);
}

static void button_changed(uint32_t button_state, uint32_t has_changed)
{
	if ((has_changed & SAP_BUTTON_MASK) == 0U) {
		return;
	}

	button_pressed = (button_state & SAP_BUTTON_MASK) != 0U;
	(void)k_work_submit(&button_report_work);
}
#endif

static ssize_t sap_auth_write(struct bt_conn *conn,
			      const struct bt_gatt_attr *attr,
			      const void *buf, uint16_t len, uint16_t offset,
			      uint8_t flags)
{
	struct sap_session *session;
	int err;

	ARG_UNUSED(attr);
	ARG_UNUSED(flags);

	if (offset != 0U) {
		return BT_GATT_ERR(BT_ATT_ERR_INVALID_OFFSET);
	}

	session = sap_session_from_conn(&sap_ctx, conn);
	if (session == NULL) {
		return BT_GATT_ERR(BT_ATT_ERR_UNLIKELY);
	}

	err = sap_handle_auth_rx(session, buf, len);
	if (err != 0) {
		return BT_GATT_ERR(BT_ATT_ERR_AUTHORIZATION);
	}

	return len;
}

static ssize_t sap_secure_rx_write(struct bt_conn *conn,
				   const struct bt_gatt_attr *attr,
				   const void *buf, uint16_t len, uint16_t offset,
				   uint8_t flags)
{
	struct sap_session *session;
	int err;

	ARG_UNUSED(attr);
	ARG_UNUSED(flags);

	if (offset != 0U) {
		return BT_GATT_ERR(BT_ATT_ERR_INVALID_OFFSET);
	}

	session = sap_session_from_conn(&sap_ctx, conn);
	if (session == NULL) {
		return BT_GATT_ERR(BT_ATT_ERR_UNLIKELY);
	}

	err = sap_handle_secure_rx(session, buf, len);
	if (err != 0) {
		return BT_GATT_ERR(BT_ATT_ERR_AUTHORIZATION);
	}

	return len;
}

static ssize_t protected_status_read(struct bt_conn *conn,
				     const struct bt_gatt_attr *attr,
				     void *buf, uint16_t len, uint16_t offset)
{
	struct sap_session *session;
	char message[48];
	int msg_len;

	ARG_UNUSED(attr);

	session = sap_session_from_conn(&sap_ctx, conn);
	if (session == NULL || !sap_is_authenticated(session)) {
		return BT_GATT_ERR(BT_ATT_ERR_AUTHORIZATION);
	}

	msg_len = snprintk(message, sizeof(message), "peripheral-%u-ready",
			   session->ctx->policy.local_credential->cert.body.device_id);

	return bt_gatt_attr_read(conn, attr, buf, len, offset, message, msg_len);
}

static void advertising_retry_fn(struct k_work *work)
{
	ARG_UNUSED(work);
	advertising_start();
}

static void schedule_advertising_restart(k_timeout_t delay)
{
	advertising_restart_pending = true;
	(void)k_work_reschedule(&advertising_retry_work, delay);
}

static void advertising_start(void)
{
	int err;

	(void)k_work_cancel_delayable(&advertising_retry_work);
	if (connection_active) {
		advertising_restart_pending = true;
		return;
	}

	err = bt_le_adv_start(BT_LE_ADV_CONN_FAST_1, sap_ad, ARRAY_SIZE(sap_ad),
			      NULL, 0);
	if (err == -EALREADY) {
		advertising_restart_pending = false;
		return;
	}

	if (err != 0) {
		LOG_ERR("Advertising failed to start (%d)", err);
		schedule_advertising_restart(K_MSEC(SAP_ADV_RESTART_DELAY_MS));
		return;
	}

	advertising_restart_pending = false;
	LOG_INF("SAP peripheral advertising");
	SAP_TRACE("FLOW BLE: peripheral advertising SAP service UUID only");
}

static void connected(struct bt_conn *conn, uint8_t err)
{
	struct sap_session *session;

	if (err != 0U) {
		LOG_ERR("Peripheral connection failed (0x%02x)", err);
		connection_active = false;
		schedule_advertising_restart(K_MSEC(SAP_ADV_RESTART_DELAY_MS));
		return;
	}

	connection_active = true;
	SAP_TRACE("FLOW 1/8 peripheral BLE link established");
	advertising_restart_pending = false;
	(void)k_work_cancel_delayable(&advertising_retry_work);

	session = sap_on_connected(&sap_ctx, conn);
	if (session == NULL) {
		LOG_ERR("No SAP session slots left");
		connection_active = false;
		(void)bt_conn_disconnect(conn, BT_HCI_ERR_CONN_LIMIT_EXCEEDED);
		return;
	}
}

static void disconnected(struct bt_conn *conn, uint8_t reason)
{
	LOG_INF("Peripheral disconnected reason 0x%02x %s", reason,
		bt_hci_err_to_str(reason));
	connection_active = false;
	protected_service_disable();
	sap_on_disconnected(&sap_ctx, conn);
	schedule_advertising_restart(K_MSEC(SAP_ADV_RESTART_DELAY_MS));
}

static void security_changed(struct bt_conn *conn, bt_security_t level,
			     enum bt_security_err err)
{
	struct sap_session *session = sap_session_from_conn(&sap_ctx, conn);

	if (session != NULL) {
		sap_on_security_changed(session, level, err);
	}

	if (err != 0) {
		clear_bond_on_security_failure(conn, err);
		LOG_ERR("Security failed: %d %s", err, bt_security_err_to_str(err));
		(void)bt_conn_disconnect(conn, BT_HCI_ERR_AUTH_FAIL);
		schedule_advertising_restart(K_MSEC(SAP_SECURITY_FAILURE_RETRY_MS));
		return;
	}

	if (session != NULL) {
		SAP_TRACE("FLOW 2/8 peripheral BLE security satisfied");
	}
}

static void recycled(void)
{
	if (advertising_restart_pending && !connection_active) {
		SAP_TRACE("FLOW reset-recovery: peripheral connection object recycled, advertising can restart");
		(void)k_work_reschedule(&advertising_retry_work, K_NO_WAIT);
	}
}

BT_CONN_CB_DEFINE(peripheral_conn_callbacks) = {
	.connected = connected,
	.disconnected = disconnected,
	.security_changed = security_changed,
	.recycled = recycled,
};

#if defined(CONFIG_SAP_SHELL)
static int join_shell_args(size_t argc, char **argv, size_t start_idx,
			   char *buffer, size_t buffer_len)
{
	size_t i;
	size_t used = 0U;

	if ((start_idx >= argc) || (buffer_len == 0U)) {
		return -EINVAL;
	}

	for (i = start_idx; i < argc; i++) {
		size_t arg_len = strlen(argv[i]);

		if ((used != 0U) && (used + 1U >= buffer_len)) {
			return -ENOSPC;
		}

		if (used != 0U) {
			buffer[used++] = ' ';
		}

		if (used + arg_len >= buffer_len) {
			return -ENOSPC;
		}

		memcpy(&buffer[used], argv[i], arg_len);
		used += arg_len;
	}

	buffer[used] = '\0';
	return (int)used;
}

static int send_text_to_central(const char *text)
{
	struct sap_session *session = active_session(true);

	if (session == NULL) {
		return -ENOTCONN;
	}

	return sap_send_secure(session, SAP_MSG_SECURE_DATA,
			       (const uint8_t *)text, strlen(text));
}

static int cmd_sap_status(const struct shell *sh, size_t argc, char **argv)
{
	struct sap_session *session = active_session(false);
	unsigned int button_state = 0U;

	ARG_UNUSED(argc);
	ARG_UNUSED(argv);

	if (session == NULL) {
		shell_print(sh, "No active SAP session");
		return 0;
	}

	#if defined(CONFIG_SAP_DK_IO)
	button_state = button_pressed ? 1U : 0U;
	#endif

	shell_print(sh, "connected=1 authenticated=%u central_id=%u button1=%u",
		    sap_is_authenticated(session) ? 1U : 0U,
		    session->peer_cert.body.device_id,
		    button_state);
	return 0;
}

static int cmd_sap_send(const struct shell *sh, size_t argc, char **argv)
{
	char payload[160];
	int err;

	err = join_shell_args(argc, argv, 1U, payload, sizeof(payload));
	if (err < 0) {
		shell_error(sh, "Text is too long for one SAP payload");
		return err;
	}

	err = send_text_to_central(payload);
	if (err != 0) {
		shell_error(sh, "Failed to send secure text (%d)", err);
		return err;
	}

	shell_print(sh, "Sent secure text to central: %s", payload);
	return 0;
}

#if defined(CONFIG_SAP_DK_IO)
static int cmd_sap_button(const struct shell *sh, size_t argc, char **argv)
{
	ARG_UNUSED(argc);

	if (strcmp(argv[1], "pressed") == 0) {
		button_pressed = true;
	} else if (strcmp(argv[1], "released") == 0) {
		button_pressed = false;
	} else if (strcmp(argv[1], "toggle") == 0) {
		button_pressed = !button_pressed;
	} else {
		shell_error(sh, "Use 'pressed', 'released', or 'toggle'");
		return -EINVAL;
	}

	(void)k_work_submit(&button_report_work);
	shell_print(sh, "Peripheral button 1 state is now %s",
		    button_pressed ? "pressed" : "released");
	return 0;
}
#endif

SHELL_STATIC_SUBCMD_SET_CREATE(sap_cmds,
	SHELL_CMD(status, NULL, "Show current SAP peripheral status", cmd_sap_status),
	SHELL_CMD_ARG(send, NULL, "send <text...>", cmd_sap_send, 2, 14),
#if defined(CONFIG_SAP_DK_IO)
	SHELL_CMD_ARG(button, NULL, "button <pressed|released|toggle>", cmd_sap_button, 2, 0),
#endif
	SHELL_SUBCMD_SET_END
);

SHELL_CMD_REGISTER(sap, &sap_cmds, "SAP demo commands", NULL);
#endif

int sap_peripheral_run(const struct sap_policy *policy)
{
	struct sap_callbacks callbacks = {
		.send_auth = send_auth,
		.send_secure = send_secure,
		.authenticated = on_authenticated,
		.authentication_failed = on_auth_failed,
		.secure_payload_received = on_secure_payload,
	};
	int err;

	err = sap_init(&sap_ctx, SAP_ROLE_PERIPHERAL, policy, &callbacks);
	if (err != 0) {
		LOG_ERR("Failed to initialize SAP core (%d)", err);
		return 0;
	}

#if defined(CONFIG_SAP_DK_IO)
	err = dk_buttons_init(button_changed);
	if (err != 0) {
		LOG_WRN("Failed to initialize DK buttons (%d)", err);
	} else {
		button_pressed = (dk_get_buttons() & SAP_BUTTON_MASK) != 0U;
	}
#endif

	advertising_start();
	return 0;
}
```

## src/sap_protocol.h
```c
/*
 * Copyright (c) 2026
 *
 * SPDX-License-Identifier: LicenseRef-Nordic-5-Clause
 */

#ifndef SAP_PROTOCOL_H__
#define SAP_PROTOCOL_H__

#include <zephyr/types.h>
#include <zephyr/bluetooth/uuid.h>

#define SAP_VERSION 1U

#define SAP_NONCE_LEN 16U
#define SAP_IDENTITY_PRIVATE_KEY_LEN 32U
#define SAP_IDENTITY_PUBLIC_KEY_LEN 65U
#define SAP_IDENTITY_SIGNATURE_LEN 64U
#define SAP_ECDH_PUBLIC_KEY_LEN 65U
#define SAP_AEAD_KEY_LEN 16U
#define SAP_AEAD_NONCE_BASE_LEN 8U
#define SAP_AEAD_NONCE_LEN 13U
#define SAP_AEAD_TAG_LEN 16U
#define SAP_SECURE_HEADER_LEN 6U

#define SAP_ROLE_MASK_CENTRAL BIT(0)
#define SAP_ROLE_MASK_PERIPHERAL BIT(1)

#define SAP_CONFIRM_TEXT "SAP-OK"
#define SAP_CONFIRM_TEXT_LEN 6U

#define BT_UUID_SAP_SERVICE_VAL \
	BT_UUID_128_ENCODE(0x7a18e2d1, 0x3bd2, 0x4f31, 0x8c4b, 0xb6c5b8f7a001)
#define BT_UUID_SAP_AUTH_VAL \
	BT_UUID_128_ENCODE(0x7a18e2d1, 0x3bd2, 0x4f31, 0x8c4b, 0xb6c5b8f7a002)
#define BT_UUID_SAP_SECURE_TX_VAL \
	BT_UUID_128_ENCODE(0x7a18e2d1, 0x3bd2, 0x4f31, 0x8c4b, 0xb6c5b8f7a003)
#define BT_UUID_SAP_SECURE_RX_VAL \
	BT_UUID_128_ENCODE(0x7a18e2d1, 0x3bd2, 0x4f31, 0x8c4b, 0xb6c5b8f7a004)
#define BT_UUID_SAP_PROTECTED_SERVICE_VAL \
	BT_UUID_128_ENCODE(0x7a18e2d1, 0x3bd2, 0x4f31, 0x8c4b, 0xb6c5b8f7a101)
#define BT_UUID_SAP_PROTECTED_STATUS_VAL \
	BT_UUID_128_ENCODE(0x7a18e2d1, 0x3bd2, 0x4f31, 0x8c4b, 0xb6c5b8f7a102)

#define BT_UUID_SAP_SERVICE BT_UUID_DECLARE_128(BT_UUID_SAP_SERVICE_VAL)
#define BT_UUID_SAP_AUTH BT_UUID_DECLARE_128(BT_UUID_SAP_AUTH_VAL)
#define BT_UUID_SAP_SECURE_TX BT_UUID_DECLARE_128(BT_UUID_SAP_SECURE_TX_VAL)
#define BT_UUID_SAP_SECURE_RX BT_UUID_DECLARE_128(BT_UUID_SAP_SECURE_RX_VAL)
#define BT_UUID_SAP_PROTECTED_SERVICE BT_UUID_DECLARE_128(BT_UUID_SAP_PROTECTED_SERVICE_VAL)
#define BT_UUID_SAP_PROTECTED_STATUS BT_UUID_DECLARE_128(BT_UUID_SAP_PROTECTED_STATUS_VAL)

enum sap_role {
	SAP_ROLE_CENTRAL = 1,
	SAP_ROLE_PERIPHERAL = 2,
};

enum sap_message_type {
	SAP_MSG_HELLO = 1,
	SAP_MSG_PERIPHERAL_CHALLENGE = 2,
	SAP_MSG_CENTRAL_AUTH = 3,
	SAP_MSG_PERIPHERAL_AUTH = 4,
	SAP_MSG_CONFIRM = 5,
	SAP_MSG_CONFIRM_ACK = 6,
	SAP_MSG_SECURE_DATA = 7,
	SAP_MSG_SECURE_ACK = 8,
	SAP_MSG_BUTTON_STATE = 9,
};

enum sap_signature_purpose {
	SAP_SIG_PERIPHERAL_CHALLENGE = 0xA1,
	SAP_SIG_CENTRAL_AUTH = 0xA2,
	SAP_SIG_PERIPHERAL_AUTH = 0xA3,
};

struct sap_cert_body {
	uint8_t version;
	uint8_t role_mask;
	uint8_t device_id;
	uint8_t group_id;
	uint8_t public_key[SAP_IDENTITY_PUBLIC_KEY_LEN];
} __packed;

struct sap_certificate {
	struct sap_cert_body body;
	uint8_t ca_signature[SAP_IDENTITY_SIGNATURE_LEN];
} __packed;

struct sap_msg_hello {
	uint8_t version;
	uint8_t type;
	uint8_t central_nonce[SAP_NONCE_LEN];
} __packed;

struct sap_msg_peripheral_challenge {
	uint8_t version;
	uint8_t type;
	struct sap_certificate cert;
	uint8_t peripheral_nonce[SAP_NONCE_LEN];
	uint8_t signature[SAP_IDENTITY_SIGNATURE_LEN];
} __packed;

struct sap_msg_central_auth {
	uint8_t version;
	uint8_t type;
	struct sap_certificate cert;
	uint8_t ecdh_public_key[SAP_ECDH_PUBLIC_KEY_LEN];
	uint8_t signature[SAP_IDENTITY_SIGNATURE_LEN];
} __packed;

struct sap_msg_peripheral_auth {
	uint8_t version;
	uint8_t type;
	uint8_t ecdh_public_key[SAP_ECDH_PUBLIC_KEY_LEN];
	uint8_t signature[SAP_IDENTITY_SIGNATURE_LEN];
} __packed;

struct sap_secure_header {
	uint8_t version;
	uint8_t type;
	uint32_t counter_le;
} __packed;

#endif /* SAP_PROTOCOL_H__ */
```

## src/sap_service.h
```c
/*
 * Copyright (c) 2026
 *
 * SPDX-License-Identifier: LicenseRef-Nordic-5-Clause
 */

#ifndef SAP_SERVICE_H__
#define SAP_SERVICE_H__

#include <stdbool.h>
#include <psa/crypto.h>
#include <zephyr/bluetooth/conn.h>

#include "sap_protocol.h"
#include "sap_credentials.h"

struct sap_context;

enum sap_session_state {
	SAP_STATE_IDLE = 0,
	SAP_STATE_WAIT_PERIPHERAL_CHALLENGE,
	SAP_STATE_WAIT_CENTRAL_AUTH,
	SAP_STATE_WAIT_PERIPHERAL_AUTH,
	SAP_STATE_WAIT_CONFIRM,
	SAP_STATE_WAIT_CONFIRM_ACK,
	SAP_STATE_AUTHENTICATED,
	SAP_STATE_FAILED,
};

struct sap_policy {
	const struct sap_device_credential *local_credential;
	const uint8_t *ca_public_key;
	size_t ca_public_key_len;
	uint8_t expected_group_id;
	uint8_t allowed_central_id;
	bool require_ble_encryption;
};

struct sap_session {
	struct sap_context *ctx;
	struct bt_conn *conn;
	void *user_data;
	enum sap_role role;
	enum sap_session_state state;
	bool in_use;
	bool security_ready;
	bool session_key_ready;
	bool authenticated_notified;
	struct sap_certificate peer_cert;
	uint8_t local_nonce[SAP_NONCE_LEN];
	uint8_t peer_nonce[SAP_NONCE_LEN];
	uint8_t local_ecdh_public[SAP_ECDH_PUBLIC_KEY_LEN];
	size_t local_ecdh_public_len;
	uint8_t peer_ecdh_public[SAP_ECDH_PUBLIC_KEY_LEN];
	size_t peer_ecdh_public_len;
	uint8_t tx_nonce_base[SAP_AEAD_NONCE_BASE_LEN];
	uint8_t rx_nonce_base[SAP_AEAD_NONCE_BASE_LEN];
	uint32_t tx_counter;
	uint32_t rx_counter;
	psa_key_id_t local_ecdh_key_id;
	psa_key_id_t aead_key_id;
};

struct sap_callbacks {
	int (*send_auth)(struct sap_session *session, const uint8_t *data, size_t len);
	int (*send_secure)(struct sap_session *session, const uint8_t *data, size_t len);
	void (*authenticated)(struct sap_session *session);
	void (*authentication_failed)(struct sap_session *session, int reason);
	void (*secure_payload_received)(struct sap_session *session, uint8_t msg_type,
					const uint8_t *data, size_t len);
};

struct sap_context {
	enum sap_role role;
	struct sap_policy policy;
	struct sap_callbacks callbacks;
	struct sap_session sessions[CONFIG_SAP_MAX_PEERS];
	psa_key_id_t local_sign_key_id;
};

int sap_init(struct sap_context *ctx, enum sap_role role,
	     const struct sap_policy *policy,
	     const struct sap_callbacks *callbacks);
void sap_uninit(struct sap_context *ctx);

struct sap_session *sap_on_connected(struct sap_context *ctx, struct bt_conn *conn);
void sap_on_disconnected(struct sap_context *ctx, struct bt_conn *conn);
struct sap_session *sap_session_from_conn(struct sap_context *ctx,
					  struct bt_conn *conn);

void sap_on_security_changed(struct sap_session *session, bt_security_t level,
			     enum bt_security_err err);
bool sap_is_authenticated(const struct sap_session *session);

int sap_start(struct sap_session *session);
int sap_handle_auth_rx(struct sap_session *session, const uint8_t *data, size_t len);
int sap_handle_secure_rx(struct sap_session *session, const uint8_t *data, size_t len);
int sap_send_secure(struct sap_session *session, uint8_t msg_type,
		    const uint8_t *payload, size_t len);

#endif /* SAP_SERVICE_H__ */
```

## src/sap_trace.h
```c
/*
 * Copyright (c) 2026
 *
 * SPDX-License-Identifier: LicenseRef-Nordic-5-Clause
 */

#ifndef SAP_TRACE_H__
#define SAP_TRACE_H__

#include <zephyr/logging/log.h>

#include "sap_protocol.h"

#define SAP_TRACE_COLOR_PREFIX "\x1b[1;96m[SAP FLOW]\x1b[0m "
#define SAP_PACKET_TRACE_COLOR_PREFIX "\x1b[1;93m[SAP PACKET]\x1b[0m "

static inline const char *sap_role_str(enum sap_role role)
{
	switch (role) {
	case SAP_ROLE_CENTRAL:
		return "central";
	case SAP_ROLE_PERIPHERAL:
		return "peripheral";
	default:
		return "unknown";
	}
}

static inline const char *sap_msg_type_str(uint8_t type)
{
	switch (type) {
	case SAP_MSG_HELLO:
		return "HELLO";
	case SAP_MSG_PERIPHERAL_CHALLENGE:
		return "PERIPHERAL_CHALLENGE";
	case SAP_MSG_CENTRAL_AUTH:
		return "CENTRAL_AUTH";
	case SAP_MSG_PERIPHERAL_AUTH:
		return "PERIPHERAL_AUTH";
	case SAP_MSG_CONFIRM:
		return "CONFIRM";
	case SAP_MSG_CONFIRM_ACK:
		return "CONFIRM_ACK";
	case SAP_MSG_SECURE_DATA:
		return "SECURE_DATA";
	case SAP_MSG_SECURE_ACK:
		return "SECURE_ACK";
	case SAP_MSG_BUTTON_STATE:
		return "BUTTON_STATE";
	default:
		return "UNKNOWN";
	}
}

#if defined(CONFIG_SAP_DEMO_LOGGING)
#define SAP_TRACE(...) LOG_DBG(SAP_TRACE_COLOR_PREFIX __VA_ARGS__)
#else
#define SAP_TRACE(...) do { } while (0)
#endif

#if defined(CONFIG_SAP_DEMO_LOGGING)
#define SAP_INFO_IF_NO_DEMO(...) do { } while (0)
#else
#define SAP_INFO_IF_NO_DEMO(...) LOG_INF(__VA_ARGS__)
#endif

#if defined(CONFIG_SAP_PACKET_LOGGING)
#define SAP_PACKET_TRACE(...) LOG_DBG(SAP_PACKET_TRACE_COLOR_PREFIX __VA_ARGS__)
#define SAP_PACKET_DUMP(data, len, label) \
	LOG_HEXDUMP_DBG(data, len, SAP_PACKET_TRACE_COLOR_PREFIX label)
#else
#define SAP_PACKET_TRACE(...) do { } while (0)
#define SAP_PACKET_DUMP(data, len, label) do { } while (0)
#endif

#endif /* SAP_TRACE_H__ */
```

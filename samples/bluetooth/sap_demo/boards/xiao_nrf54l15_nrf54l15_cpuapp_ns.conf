## samples/bluetooth/sap_demo/boards/xiao_nrf54l15_nrf54l15_cpuapp_ns.conf
```kconfig
#
# Copyright (c) 2026
#
# SPDX-License-Identifier: LicenseRef-Nordic-5-Clause
#

# The XIAO nRF54L15 /ns build is stable with GRTC as the system timer.
CONFIG_NRF_GRTC_TIMER=y
CONFIG_NRF_GRTC_START_SYSCOUNTER=y
# CONFIG_CORTEX_M_SYSTICK is not set
CONFIG_SYS_CLOCK_HW_CYCLES_PER_SEC=128000000

# The XIAO /ns leaf demo runs without persisted settings for now. This avoids
# a settings backend init failure on the board while keeping BLE security and
# SAP re-auth working after reconnect/reset.
# CONFIG_SETTINGS is not set
# CONFIG_SETTINGS_NVS is not set
# CONFIG_NVS is not set
# CONFIG_BT_SETTINGS is not set
```

## samples/bluetooth/sap_demo/sysbuild/mcuboot/boards/nrf54l15dk_nrf54l15_cpuapp.conf
```kconfig
#
# Copyright (c) 2026
#
# SPDX-License-Identifier: LicenseRef-Nordic-5-Clause
#

# The DK root build does not need a UART-facing MCUboot console. Disabling
# it keeps the stock /ns partitioning viable without the oversized direct-XIP
# DK partition map.
CONFIG_CONSOLE=n
CONFIG_PRINTK=n
CONFIG_SERIAL=n
CONFIG_UART_CONSOLE=n
CONFIG_LOG=n
CONFIG_MCUBOOT_LOG_LEVEL_OFF=y
CONFIG_BOOT_BANNER=n
CONFIG_NCS_BOOT_BANNER=n
CONFIG_CBPRINTF_NANO=y
CONFIG_ASSERT=n
CONFIG_ASSERT_VERBOSE=n
CONFIG_EARLY_CONSOLE=n
```

## samples/bluetooth/sap_demo/sysbuild/mcuboot/boards/xiao_nrf54l15_nrf54l15_cpuapp.conf
```kconfig
# XIAO uses a large internal-RRAM slot, so MCUboot needs a larger sector cap
# than the generic default in order to validate slot 0.
CONFIG_BOOT_MAX_IMG_SECTORS=512
```
